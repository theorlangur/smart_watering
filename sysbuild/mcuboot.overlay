#include "../dts/partitions.dtsi"
#include "../dts/usb_uart.dtsi"
#include "../dts/buttons.dtsi"
/ {
	chosen {
		zephyr,code-partition = &boot_partition;
		zephyr,uart-mcumgr = &uart00;
	};

	aliases {
		mcuboot-button0 = &button0;
	};
};


